## board/lab/micro2440/Kconfig
```kconfig
if TARGET_MICRO2440

config SYS_BOARD
	default "micro2440"

config SYS_VENDOR
	default "lab"

config SYS_SOC
	default "s3c24x0"

config SYS_CONFIG_NAME
	default "micro2440"

endif
```
